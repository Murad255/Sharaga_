/*
 * Все кнопки подключены к одному аналоговому входу «A0» используя цепочку резисторов, которые выдают разное опорное напряжение для «А0» при нажатии любой кнопки. 
 * Eсли кнопки не нажаты напряжение на «A0» через резистор R2 (2кОм) будет 5В. Другие резисторы не влияют на схему, а при чтении аналогового вывода «A0» будет 
 * параметр на верхнем приделе 1023 (или приблизительно). Теперь рассмотрим, что произойдет, если будет нажата кнопка «Вниз». На выводе «А0» будет напряжением, 
 * которое разделено между резистором R2 (2кОм) которое подтянуто к +5В и резисторами R3 (330ОМ) и R4 (620Ом) общий суммой 950Ом, которые пытаются тянуть его вниз 
 * к 0В. Напряжения на «A0» будет составлять порядка 1.61В, это означает, что если выполнить команду analogRead () на A0, будет возвращено значение около 306, 
 * что означает нажатие кнопки «Вниз»
 * Напряжением и значение analogRead
 * RIGNT: 0.00В: 0 — 8 bit; 0 — 10 bit
 * UP: 0.71В: 36 — 8 bit; 145 — 10 bit
 * DOWN: 1.61В: 82 — 8 bit; 306 — 10 bit
 * LEFT: 2.47В: 126 — 8 bit; 505 — 10 bit
 * SELECT: 3.62В: 185 — 8 bit; 741 — 10 bit
 * 
 * Это позволяет сэкономить целый набор выводов и использовать их для более нужного использования. 
 */

#include <LiquidCrystal.h>                // Подключяем библиотеку
LiquidCrystal lcd( 8, 9, 4, 5, 6, 7 );    // Указываем ноги индикатора
#define NUM_LAB 3                         // Номер лабораторной работы
// Функция вывода стартового экрана
// Входной параметр - номер примера
void msgStart(uint8_t ex)
{
  Serial.print(F("\n"));
  Serial.print(F("Laboratory work "));Serial.println(NUM_LAB);
  Serial.print(F("Example "));Serial.println(ex);
  Serial.print(F("Build firmware "));Serial.print(__TIME__); Serial.print(" ");Serial.println(__DATE__);
  Serial.print(F("Microcontroller frequency [Mhz] "));Serial.println(F_CPU/1000000);
    extern int __heap_start, *__brkval; 
    int v; 
    int fr = (int) &v - (__brkval == 0 ? (int) &__heap_start : (int) __brkval); 
    Serial.print(F("Free ram: ")); Serial.println(fr);
  Serial.print(F("Start code ----->\n"));
}
 
void setup()
{
  lcd.begin(16, 2);                       // Инициализируем LCD 16x2  
  lcd.setCursor(0,0);                     // Установить курсор на первую строку  
  lcd.print("LCD1602");                   // Вывести текст
  lcd.setCursor(0,1);                     // Установить курсор на вторую строку
  lcd.print("Key press");                 // Вывести текст
  Serial.begin(115200);                   // Включаем последовательный порт
  msgStart(7);
}
 
void loop() { 
  int x;                                  // Создаем переменную x
  x = analogRead (0);                     // Задаем номер порта с которого производим считывание 
  lcd.setCursor(10,1);                    // Установить курсор на вторую строку 
  if (x < 100) {                          // Если x меньше 100 перейти на следующею строк
  lcd.print ("Right ");                   // Вывести текст 
  Serial.print("Value A0 ‘Right’ is  :"); // Вывести текст
  Serial.println(x,DEC);                  // Вывести значение переменной x
}
  else if (x < 200) {                     // Если х меньше 200 перейти на следующию строку
  lcd.print ("Up    ");                   // Вывести текст 
  Serial.print("Value A0 ‘UP’ is  :");    // Вывести текст
  Serial.println(x,DEC);                  // Вывести значение переменной x
}
  else if (x < 400){                      // Если х меньше 400 перейти на следующию строку
  lcd.print ("Down  ");                   // Вывести текст
  Serial.print("Value A0 ‘Down’ is  :");  // Вывести текст
  Serial.println(x,DEC);                  // Вывести значение переменной x
}
  else if (x < 600){                      // Если х меньше 600 перейти на следующию строку
  lcd.print ("Left  ");                   // Вывести текст
  Serial.print("Value A0 ‘Left’ is  :");  // Вывести текст
  Serial.println(x,DEC);                  // Вывести значение переменной x
}
  else if (x < 800){                      // Если х меньше 800 перейти на следующию строку
  lcd.print ("Select");                   // Вывести текст
  Serial.print("Value A0 ‘Select’ is  :");// Вывести текст
  Serial.println(x,DEC);                  // Вывести значение переменной x
}
}
